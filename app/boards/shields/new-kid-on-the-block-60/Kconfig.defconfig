## app/boards/shields/new-kid-on-the-block-60/Kconfig.defconfig
```kconfig
if SHIELD_NEW_KID_ON_THE_BLOCK_60

config ZMK_KEYBOARD_NAME
    default "block-60"

endif
```

## app/boards/shields/new-kid-on-the-block-60/Kconfig.shield
```kconfig
config SHIELD_NEW_KID_ON_THE_BLOCK_60
    def_bool $(shields_list_contains,new-kid-on-the-block-60)
```
